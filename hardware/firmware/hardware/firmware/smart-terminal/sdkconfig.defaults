## hardware/firmware/hardware/firmware/smart-terminal/sdkconfig.defaults
```kconfig
# 项目默认配置。首次 `idf.py set-target esp32s3` 或删除 sdkconfig 后会套用这些值。
# 具体取值与实测工程一致（ESP-IDF v5.2.2）。

# ---------- 目标与 Flash ----------
CONFIG_IDF_TARGET="esp32s3"
CONFIG_ESPTOOLPY_FLASHSIZE_8MB=y
CONFIG_ESPTOOLPY_FLASHSIZE="8MB"
CONFIG_PARTITION_TABLE_SINGLE_APP=y

# ---------- PSRAM（八线，摄像头帧缓冲必需）----------
# 八线 PSRAM 模组：保持 OCT；若换成四线（如 N8R2），改成 CONFIG_SPIRAM_MODE_QUAD=y
CONFIG_SPIRAM=y
CONFIG_SPIRAM_MODE_OCT=y
CONFIG_SPIRAM_TYPE_AUTO=y
CONFIG_SPIRAM_SPEED_80M=y
CONFIG_SPIRAM_BOOT_INIT=y
CONFIG_SPIRAM_USE_MALLOC=y
CONFIG_SPIRAM_MALLOC_ALWAYSINTERNAL=16384
CONFIG_SPIRAM_MALLOC_RESERVE_INTERNAL=32768
CONFIG_SPIRAM_TRY_ALLOCATE_WIFI_LWIP=y
CONFIG_SPIRAM_ALLOW_STACK_EXTERNAL_MEMORY=y

# ---------- 缓存（DVP 摄像头取数需要足够数据缓存）----------
CONFIG_ESP32S3_DATA_CACHE_32KB=y
CONFIG_ESP32S3_DATA_CACHE_LINE_32B=y
CONFIG_ESP32S3_INSTRUCTION_CACHE_16KB=y

# ---------- esp32-camera ----------
CONFIG_CAMERA_TASK_STACK_SIZE=4096
CONFIG_CAMERA_CORE0=y
CONFIG_CAMERA_DMA_BUFFER_SIZE_MAX=32768

# ---------- Wi-Fi / LWIP / MQTT ----------
CONFIG_ESP_WIFI_STATIC_RX_BUFFER_NUM=10
CONFIG_ESP_WIFI_DYNAMIC_RX_BUFFER_NUM=32
CONFIG_LWIP_TCP_SND_BUF_DEFAULT=5760
CONFIG_LWIP_TCP_WND_DEFAULT=5760
CONFIG_LWIP_MAX_SOCKETS=10
CONFIG_MQTT_PROTOCOL_311=y
CONFIG_MQTT_TRANSPORT_SSL=y

# ---------- 系统 ----------
CONFIG_FREERTOS_HZ=100
CONFIG_ESP_MAIN_TASK_STACK_SIZE=3584
CONFIG_LOG_DEFAULT_LEVEL_INFO=y
```
